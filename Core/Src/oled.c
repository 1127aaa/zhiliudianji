#include "oled.h"
#include "i2c.h"
#include <string.h>

/* SSD1306 I2C 地址（7 位 0x3C 左移一位） */
#define OLED_I2C_ADDR    0x78
#define OLED_CMD_BYTE    0x00
#define OLED_DATA_BYTE   0x40
#define OLED_WIDTH       128
#define OLED_TIMEOUT     100

/* 8x16 点阵字库（列行式，每字符 16 字节：前 8 字节上半页，后 8 字节下半页） */
static const char oled_font_chars[] = " 0123456789%:Sped";
static const uint8_t F8X16[][16] = {
  {0x00,0x00,0x00,0x00,0x00,0x00,0x00,0x00,0x00,0x00,0x00,0x00,0x00,0x00,0x00,0x00}, /* ' ' */
  {0x00,0xE0,0x10,0x08,0x08,0x10,0xE0,0x00,0x00,0x0F,0x10,0x20,0x20,0x10,0x0F,0x00}, /* '0' */
  {0x00,0x10,0x10,0xF8,0x00,0x00,0x00,0x00,0x00,0x20,0x20,0x3F,0x20,0x20,0x00,0x00}, /* '1' */
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  {0x00,0x00,0x80,0x88,0x88,0x70,0x00,0x00,0x00,0x1E,0x21,0x21,0x21,0x3F,0x20,0x00}, /* 'd' */
};

static void OLED_WriteCmd(uint8_t cmd)
{
  HAL_I2C_Mem_Write(&hi2c1, OLED_I2C_ADDR, OLED_CMD_BYTE,
                    I2C_MEMADD_SIZE_8BIT, &cmd, 1, OLED_TIMEOUT);
}

static void OLED_WriteData(uint8_t *data, uint16_t len)
{
  HAL_I2C_Mem_Write(&hi2c1, OLED_I2C_ADDR, OLED_DATA_BYTE,
                    I2C_MEMADD_SIZE_8BIT, data, len, OLED_TIMEOUT);
}

/* 设置写入位置：x 为列（0~127），page 为页（0~7，每页 8 行像素） */
static void OLED_SetPos(uint8_t x, uint8_t page)
{
  OLED_WriteCmd(0xB0 + page);
  OLED_WriteCmd(((x & 0xF0) >> 4) | 0x10);
  OLED_WriteCmd(x & 0x0F);
}

void OLED_Init(void)
{
  HAL_Delay(100);  /* 等待 SSD1306 上电稳定 */

  OLED_WriteCmd(0xAE);  /* 关显示 */
  OLED_WriteCmd(0xD5);  OLED_WriteCmd(0x80);  /* 显示时钟分频 */
  OLED_WriteCmd(0xA8);  OLED_WriteCmd(0x3F);  /* 多路复用 1/64 */
  OLED_WriteCmd(0xD3);  OLED_WriteCmd(0x00);  /* 显示偏移 0 */
  OLED_WriteCmd(0x40);                        /* 起始行 0 */
  OLED_WriteCmd(0x8D);  OLED_WriteCmd(0x14);  /* 启用电荷泵 */
  OLED_WriteCmd(0x20);  OLED_WriteCmd(0x02);  /* 页寻址模式 */
  OLED_WriteCmd(0xA1);                        /* 段重映射：列 127 映射到 SEG0 */
  OLED_WriteCmd(0xC8);                        /* COM 扫描方向：从 COM63 到 COM0 */
  OLED_WriteCmd(0xDA);  OLED_WriteCmd(0x12);  /* COM 硬件引脚配置 */
  OLED_WriteCmd(0x81);  OLED_WriteCmd(0xCF);  /* 对比度 */
  OLED_WriteCmd(0xD9);  OLED_WriteCmd(0xF1);  /* 预充电周期 */
  OLED_WriteCmd(0xDB);  OLED_WriteCmd(0x40);  /* VCOMH 电平 */
  OLED_WriteCmd(0xA4);                        /* 显示跟随 RAM */
  OLED_WriteCmd(0xA6);                        /* 正常显示（非反色） */
  OLED_WriteCmd(0xAF);  /* 开显示 */

  OLED_Clear();
}

void OLED_Clear(void)
{
  uint8_t line[OLED_WIDTH] = {0};
  for (uint8_t page = 0; page < 8; page++) {
    OLED_SetPos(0, page);
    OLED_WriteData(line, OLED_WIDTH);
  }
}

static void OLED_ShowChar(uint8_t x, uint8_t page, char ch)
{
  const uint8_t *glyph = F8X16[0];
  for (uint8_t i = 0; i < sizeof(oled_font_chars) - 1; i++) {
    if (oled_font_chars[i] == ch) {
      glyph = F8X16[i];
      break;
    }
  }

  uint8_t upper[8], lower[8];
  memcpy(upper, glyph, 8);
  memcpy(lower, glyph + 8, 8);

  OLED_SetPos(x, page);
  OLED_WriteData(upper, 8);
  OLED_SetPos(x, page + 1);
  OLED_WriteData(lower, 8);
}

void OLED_ShowString(uint8_t x, uint8_t page, const char *str)
{
  while (*str != '\0') {
    OLED_ShowChar(x, page, *str++);
    x += 8;
    if (x > OLED_WIDTH - 8) {  /* 换行到下一字符行 */
      x = 0;
      page += 2;
    }
  }
}

/* 在屏幕首行显示当前速度，格式 "Speed: xxx%" */
void OLED_ShowSpeed(int16_t speed)
{
  char buf[12] = "Speed:     ";
  buf[7]  = (speed >= 100) ? (char)('0' + speed / 100) : ' ';
  buf[8]  = (speed >= 10)  ? (char)('0' + (speed / 10) % 10) : ' ';
  buf[9]  = (char)('0' + speed % 10);
  buf[10] = '%';
  buf[11] = '\0';

  OLED_ShowString(0, 0, buf);
}
